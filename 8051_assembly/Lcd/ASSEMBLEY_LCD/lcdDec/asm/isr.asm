;SW asm\isr.asm
;--------------------------------------------------------------------
;isr_t0
;delay_1sec
;scanner
;k
;adisp1,2,3,4,disp_blank
;adisp_lut
;--------------------------------------------------------------------
;--------------------------------------------------------------------
isr_t0:
	push	a
	push	psw
	push	dph
	push	dpl

	call	init_timer0
;
	call	delay_1sec

	call	buzzer
	call	scanner		;spoils a,psw,dptr
;
;----------------------------------
	jnb	start_sw,out1_swl
	jnb	s1_over,out_isr
	call	inc_d
	clr	s1_over
out1_swl:
	jnb	stop_sw,out_isr
	jnb	s1_over,out_isr
	call	dec_d
	clr	s1_over


;-----------------------------------
;
out_isr:
	pop	dpl
	pop	dph
	pop	psw
	pop	a
	reti
;--------------------------------------------------------------------
;--------------------------------------------------------------------
;count for 1000ms (04e8h) is loaded in cnt_1sl (0e8h) and cnt_1sh (04h)
;s1_over flag initially set.
delay_1sec:
	jb	s1_over,out_d1sec
	djnz	cnt_1sl,out_d1sec
	djnz	cnt_1sh,reinit_1sl
;count over..
	mov	cnt_1sh,#04h
	mov	cnt_1sl,#0e8h
	setb	s1_over
	ret	
reinit_1sl:
	mov	cnt_1sl,#0ffh
out_d1sec:
	ret	
;--------------------------------------------------------------------
;--------------------------------------------------------------------


scanner:	
;-----------------------------------------------------------------
	mov	a,scan_no
;-----------------------------------------------------------------


;-(0)------------------------------------------------------------
zero:
	cjne	a,#00d,one		;
;----------------------------------------
;key_output_line
	clr	sl1			;
	setb	sl2			;
	setb	sl3			;
	setb	sl4			;
;----------------------------------------
	call	adisp1
;----------------------------------------
	mov	c,krl1
	call	k
;----------------------------------------
	mov	scan_no,#01d
	ajmp	out_scanner
;--------------------------------------------------------------------


;-(1)----------------------------------------------------------------
one:
	cjne	a,#01d,two		;
;----------------------------------------

;----------------------------------------
	mov	c,krl2
	call	k
;----------------------------------------
	mov	scan_no,#02d	
	ajmp	out_scanner
;--------------------------------------------------------------------


;-(2)----------------------------------------------------------------
two:
	cjne	a,#02d,three		;
;----------------------------------------

;----------------------------------------
	mov	c,krl3
	call	k
;----------------------------------------
	mov	scan_no,#03d
	ajmp	out_scanner
;--------------------------------------------------------------------



;-(3)----------------------------------------------------------------
three:
	cjne	a,#03d,four		;
;----------------------------------------
	call	disp_blank
;----------------------------------------
	mov	c,krl4
	call	k
;----------------------------------------
	mov	scan_no,#04d
	ajmp	out_scanner
;--------------------------------------------------------------------



;-(4)----------------------------------------------------------------
four:
	cjne	a,#04d,five		;
;----------------------------------------
;key_output_line
	setb	sl1			;
	clr	sl2			;
	setb	sl3			;
	setb	sl4			;
;----------------------------------------
	call	adisp2
;----------------------------------------
	mov	c,krl1
	call	k
;----------------------------------------
	mov	scan_no,#05d
	ajmp	out_scanner
;--------------------------------------------------------------------



;-(5)----------------------------------------------------------------
five:
	cjne	a,#05d,six		;
;----------------------------------------

;----------------------------------------
	mov	c,krl2
	call	k
;----------------------------------------
	mov	scan_no,#06d
	ajmp	out_scanner
;--------------------------------------------------------------------



;-(6)----------------------------------------------------------------
six:
	cjne	a,#06d,seven		;
;----------------------------------------

;----------------------------------------
	mov	c,krl3
	call	k
;----------------------------------------
	mov	scan_no,#07d
	ajmp	out_scanner
;--------------------------------------------------------------------



;-(7)----------------------------------------------------------------
seven:
	cjne	a,#07d,eight		;
;----------------------------------------
	call	disp_blank
;----------------------------------------
	mov	c,krl4
	call	k
;----------------------------------------
	mov	scan_no,#08d
	ajmp	out_scanner
;--------------------------------------------------------------------



;-(8)----------------------------------------------------------------
eight:
	cjne	a,#08d,nine		;
;----------------------------------------
;key_output_line
	setb	sl1			;
	setb	sl2			;
	clr	sl3			;
	setb	sl4			;
;----------------------------------------
	call	adisp3
;----------------------------------------
	mov	c,krl1
	call	k
;----------------------------------------
	mov	scan_no,#09d
	ajmp	out_scanner
;--------------------------------------------------------------------


;-(9)----------------------------------------------------------------
nine:
	cjne	a,#09d,ten		;
;----------------------------------------

;----------------------------------------
	mov	c,krl2
	call	k
;----------------------------------------
	mov	scan_no,#10d
	ajmp	out_scanner
;--------------------------------------------------------------------

;-(10(a))------------------------------------------------------------
ten:
	cjne	a,#10d,eleven		;
;----------------------------------------

;----------------------------------------
	mov	c,krl3
	call	k
;----------------------------------------
	mov	scan_no,#11d
	ajmp	out_scanner
;--------------------------------------------------------------------


;-(11(b))------------------------------------------------------------
eleven:
	cjne	a,#11d,twelve		;
;----------------------------------------
	call	disp_blank
;----------------------------------------
	mov	c,krl4
	call	k
;----------------------------------------
	mov	scan_no,#12d
	ajmp	out_scanner
;--------------------------------------------------------------------


;-(12(c))------------------------------------------------------------
twelve:
	cjne	a,#12d,thirteen		;
;----------------------------------------
;key_output_line
	setb	sl1			;
	setb	sl2			;
	setb	sl3			;
	clr	sl4			;
;----------------------------------------
	call	adisp4
;----------------------------------------
	mov	c,krl1
	call	k
;----------------------------------------
	mov	scan_no,#13d
	ajmp	out_scanner
;--------------------------------------------------------------------

;-(13(d))------------------------------------------------------------
thirteen:
	cjne	a,#13d,fourteen		;
;----------------------------------------

;----------------------------------------
	mov	c,krl2
	call	k
;----------------------------------------
	mov	scan_no,#14d
	ajmp	out_scanner
;--------------------------------------------------------------------

;-(14(e))------------------------------------------------------------
fourteen:
	cjne	a,#14d,fifteen		;
;----------------------------------------

;----------------------------------------
	mov	c,krl3
	call	k
;----------------------------------------
	mov	scan_no,#15d
	ajmp	out_scanner
;--------------------------------------------------------------------

;-(15(f))------------------------------------------------------------
fifteen:
	cjne	a,#15d,dummy		;
;----------------------------------------
	call	disp_blank
;----------------------------------------
	mov	c,krl4
	call	k
;----------------------------------------
dummy:	mov	scan_no,#00d
	ajmp	out_scanner
;--------------------------------------------------------------------
;--------------------------------------------------------------------
out_scanner:
;	
	ret
;-----------------------------------------------------------------------
;----------------------------------------------------------------------
;comes with c flag having the status of the corrosponding krl line.
k:
	jb	key_ready,out_debounce
;-------------------------------------
;key detect....
	mov	tb,c			;save carry bit
	mov	a,dcount
	cjne	a,#33d,debounce
	mov	c,tb			;restore carry bit
;key pressed for the first time...
	jc	out_k
	dec	dcount
	mov	key_code,scan_no	;copy the scan_no in key_code
	jmp	out_k
;-------------------------------------	
debounce:
	djnz	dcount,out_k
;debounce complete..now check for key press...
	mov	c,tb		;restore carry bit
	jc	spurious_key
	mov	dcount,#33d
	setb	key_ready		;key still pressed (after debounce)
	setb	start_buzzer	;buzzer on
	jmp	out_k
spurious_key:
	mov	dcount,#33d
	jmp	out_k
out_debounce:
;-------------------------------------
;check for key release...
	jc	l1_k
	mov	krcount,#32d
	jmp	out_k
l1_k:
	djnz	krcount,out_k
	setb	nkp
	clr	start_buzzer	;buzzer off
	mov	krcount,#32d
;	jmp	out_k
;-------------------------------------
out_k:
	ret		
;-----------------------------------------------
;------------------------------------------
adisp1:
	IF	SSD
	mov 	dptr,#adisp_lut
	mov 	a,ds1
	clr	c
	subb	a,#"0"
	movc 	a,@a+dptr
	mov 	p0,a
	ENDIF
	ret
;------------------------------------------
;------------------------------------------
adisp2:
	IF	SSD
	mov 	dptr,#adisp_lut
	mov 	a,ds2
	clr	c
	subb	a,#"0"
	movc 	a,@a+dptr
	mov 	p0,a
	ENDIF
	ret
;------------------------------------------
;------------------------------------------
adisp3:
	IF	SSD
	mov 	dptr,#adisp_lut
	mov 	a,ds3
	clr	c
	subb	a,#"0"
	movc 	a,@a+dptr
	mov 	p0,a
	ENDIF
	ret
;------------------------------------------
;------------------------------------------
adisp4:
	IF	SSD
	mov 	dptr,#adisp_lut
	mov 	a,ds4
	clr	c
	subb	a,#"0"
	movc 	a,@a+dptr
	mov 	p0,a
	ENDIF
	ret
;------------------------------------------
;------------------------------------------
disp_blank:
	IF	SSD
	mov 	p0,#00h
	ENDIF
	ret
;------------------------------------------
;-----------------------------------------------
adisp_lut:
;		-abcdefgd-		
	db	 11111100b	;0
	db	 01100000b	;1
	db	 11011010b	;2
	db	 11110010b	;3
	db	 01100110b	;4
	db	 10110110b	;5
	db	 10111110b	;6
	db	 11100000b	;7
	db	 11111110b	;8
	db	 11100110b	;9
;
	db	 11111111b	;3a
	db	 11111111b	;3b
	db	 11111111b	;3c
	db	 11111111b	;3d
	db	 11111111b	;3e
	db	 11111111b	;3f
	db	 11111111b	;40
;
	db	 11101110b	;A
	db	 00111110b	;B
	db	 10011100b	;C
	db	 01111010b	;D
	db	 10011110b	;E
	db	 10001110b	;F
	db	 10111100b	;G
	db	 01101110b	;H
	db	 00001100b	;I
	db	 01110000b	;J
	db	 00001110b	;K
	db	 00011100b	;L
	db	 10101010b	;M
	db	 00101010b	;N
	db	 00111010b	;O
	db	 11001110b	;P
	db	 11010110b	;Q
	db	 00001010b	;R
	db	 10110110b	;S
	db	 00011110b	;T
	db	 01111100b	;U
	db	 00111000b	;V
	db	 10111000b	;W
	db	 01100010b	;X
	db	 01100110b	;Y
	db	 10010010b	;Z
	db	 00000000b	;Z+1 for space
	db	 11111111b	;Z+2 for all segment glow
;-----------------------------------------------------------------------

;-----------------------------------------------------------------------
;SW asm\isr.asm